## conf/layer.conf
```bitbake
# We have a conf and classes directory, add to BBPATH
BBPATH =. "${LAYERDIR}:"

# We have recipes-* directories, add to BBFILES
BBFILES += "${LAYERDIR}/recipes-*/*/*.bb \
            ${LAYERDIR}/recipes-*/*/*.bbappend"

BBFILE_COLLECTIONS += "ha1588"
BBFILE_PATTERN_ha1588 = "^${LAYERDIR}/"
BBFILE_PRIORITY_ha1588 = "5"

LAYERSERIES_COMPAT_ha1588 = "thud sumo rocko"

# This should only be incremented on significant changes that will
# cause compatibility issues with other layers
LAYERVERSION_ha1588 = "1"

LAYERDEPENDS_ha1588 = "core"

REQUIRED_POKY_BBLAYERS_CONF_VERSION = "2"
```
